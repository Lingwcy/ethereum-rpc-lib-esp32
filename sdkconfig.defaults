## sdkconfig.defaults
```kconfig
CONFIG_ESP_MAIN_TASK_STACK_SIZE=8192
CONFIG_FREERTOS_IDLE_TASK_STACKSIZE=2048
CONFIG_PTHREAD_TASK_STACK_SIZE_DEFAULT=6144
CONFIG_ESP_SYSTEM_EVENT_TASK_STACK_SIZE=5120
CONFIG_COMPILER_OPTIMIZATION_ASSERTIONS_ENABLE=y
CONFIG_FREERTOS_ISR_STACKSIZE=2048
CONFIG_ESP_TIMER_TASK_STACK_SIZE=4096
```
